/*
 * Custom Unicode characters used across petergil's keymaps, including the
 * Swedish letters (&sv_ae, &sv_ao, &sv_oe).
 *
 * Prerequisite (before this file): `#define HOST_OS <n>` — see
 * https://github.com/urob/zmk-helpers#zmk_unicode for values. Everything else
 * (zmk-helpers itself) is pulled in automatically.
 */

#include "zmk-helpers/helper.h"
#include "zmk-helpers/unicode-chars/swedish.dtsi"

ZMK_UNICODE_SINGLE(euro_sign, N2, N0, A, C) // €

                                          // punctuation
ZMK_UNICODE_SINGLE(bang, N2, N0, N3, D)    // ‽
ZMK_UNICODE_SINGLE(irony     , N2, E, N2, E)    // ⸮
                                          // emojis
ZMK_UNICODE_SINGLE(checkmark , N2, N7, N0, N5)    // ✅
ZMK_UNICODE_SINGLE(cross     , N2, N7, N4, C)    // ❌
ZMK_UNICODE_SINGLE(shamrock  , N2, N6, N1, N8)    // ☘
ZMK_UNICODE_SINGLE(rad       , N2, N6, N2, N2)    // ☢
ZMK_UNICODE_SINGLE(bio       , N2, N6, N2, N3)    // ☣
ZMK_UNICODE_SINGLE(CCCP      , N2, N6, N2, D)    // ☭
ZMK_UNICODE_SINGLE(lighting  , N2, N6, A, N1)    // ⚡
