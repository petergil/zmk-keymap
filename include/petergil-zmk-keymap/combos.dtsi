/*
 * Thumb-cluster combos for MED_L / FUN_L access.
 *
 * Key positions (PG_THUMB_*) come from the selected layout header (see
 * layout.h), the same one keymap.dtsi's PG_LAYOUT uses, so they match the
 * bindings order.
 * If you include this file standalone with your own bindings, select the
 * layout header that matches those bindings, or these combos will silently
 * bind to the wrong physical keys rather than fail to compile.
 */

#include "petergil-zmk-keymap/layout.h"
#include "petergil-zmk-keymap/layers.h"

/ {
    combos {
        compatible = "zmk,combos";

        med_mo {
            timeout-ms = <50>;
            key-positions = <PG_THUMB_L_OUTER PG_THUMB_L_INNER>;
            bindings = <&mo MED_L>;
        };

        fn_mo {
            timeout-ms = <50>;
            key-positions = <PG_THUMB_R_INNER PG_THUMB_R_OUTER>;
            bindings = <&mo FUN_L>;
        };
    };
};
